## behaviors/Kconfig
```kconfig
menu "PMW3360 runtime behaviors"

config ZMK_BEHAVIOR_PMW3360_RUNTIME_HOOKS
    bool
    default y
    help
      Build the weak runtime hook implementation used by the PMW3360 runtime
      tuning behaviors.

      Boards may override the hook with a strong symbol to trigger custom
      status updates or visual feedback whenever CPI or burst accumulation is
      changed at runtime.

config ZMK_BEHAVIOR_PMW3360_RUNTIME_PERSISTENCE
    bool
    default y
    depends on INPUT_PIXART_PMW3360 && SETTINGS
    help
      Enable PMW3360 runtime tuning persistence through Zephyr settings.

      This stores and restores the currently selected CPI and burst
      accumulation values for the convenience behaviors shipped by this
      module. Persisted values are restored after boot and after firmware
      reflash as long as the keyboard settings storage is preserved.

config ZMK_BEHAVIOR_PMW3360_CPI_CYCLE
    bool "PMW3360 CPI cycle behavior"
    default y
    depends on INPUT_PIXART_PMW3360
    help
      Expose a directly usable ZMK behavior that cycles PMW3360 CPI values at
      runtime.

      This behavior assumes a single enabled PMW3360 device in the build and
      is intended for keymap-level runtime tuning such as CPI up/down buttons.

config ZMK_BEHAVIOR_PMW3360_BURST_ACCUMULATION_CYCLE
    bool "PMW3360 burst accumulation cycle behavior"
    default y
    depends on INPUT_PIXART_PMW3360
    help
      Expose a directly usable ZMK behavior that cycles the PMW3360 burst
      accumulation limit at runtime.

      This is primarily useful on BLE pointing builds where one-burst-per-HID-
      report can create visible report backlog under fast motion.

config ZMK_BEHAVIOR_PMW3360_SAVE_SETTINGS
    bool "PMW3360 save runtime settings behavior"
    default y
    depends on INPUT_PIXART_PMW3360 && SETTINGS
    select ZMK_BEHAVIOR_PMW3360_RUNTIME_PERSISTENCE
    help
      Expose a directly usable ZMK behavior that saves the current PMW3360
      runtime CPI and burst accumulation values to persistent settings.

      This is intended for keymaps that want an explicit "commit current PMW
      tuning" action instead of writing to flash on every CPI or burst
      accumulation change.

endmenu
```

## ci/smoke-config/boards/shields/pmw3360_smoke/Kconfig.defconfig
```kconfig
# Copyright (c) 2026 Matthias Fulz
# SPDX-License-Identifier: MIT

if SHIELD_PMW3360_SMOKE

config ZMK_KEYBOARD_NAME
    default "PMW3360 Smoke"

endif
```

## ci/smoke-config/boards/shields/pmw3360_smoke/Kconfig.shield
```kconfig
# Copyright (c) 2026 Matthias Fulz
# SPDX-License-Identifier: MIT

config SHIELD_PMW3360_SMOKE
    def_bool $(shields_list_contains,pmw3360_smoke)
```

## drivers/input/Kconfig
```kconfig
# Copyright (c) 2025 George Norton
# Copyright (c) 2026 Matthias Fulz
# SPDX-License-Identifier: MIT
#
# PMW3360 optical motion sensor driver configuration.

menuconfig INPUT_PIXART_PMW3360
    bool "PixArt PMW3360 optical motion sensor"
    default y
    select GPIO
    select SPI
    depends on INPUT
    depends on DT_HAS_PIXART_PMW3360_ENABLED
    help
      Enable the PixArt PMW3360 relative pointing sensor driver.

      The PMW3360 is commonly used in custom mice and trackball builds. This
      driver supports both interrupt-driven operation via the MOTION pin and a
      polling fallback when no motion interrupt is wired.

config INPUT_PIXART_PMW3360_USE_OWN_THREAD
    bool "Process PMW3360 work on a dedicated driver work queue"
    default y
    help
      Run PMW3360 initialization and motion processing on a private work queue
      instead of the shared system work queue.

      This costs additional RAM for a dedicated stack but gives the pointing
      path more isolation from unrelated work queue traffic, which can improve
      responsiveness on BLE builds under load.

config INPUT_PIXART_PMW3360_THREAD_PRIORITY
    int "PMW3360 dedicated work queue priority"
    depends on INPUT_PIXART_PMW3360_USE_OWN_THREAD
    default 5
    help
      Thread priority used for the PMW3360 dedicated work queue.

      Lower numeric values run with higher priority in Zephyr.

config INPUT_PIXART_PMW3360_THREAD_STACK_SIZE
    int "PMW3360 dedicated work queue stack size"
    depends on INPUT_PIXART_PMW3360_USE_OWN_THREAD
    default 768
    help
      Stack size reserved for the PMW3360 dedicated work queue thread.

      Increase this only if debugging or future driver changes require more
      stack space. The default is intentionally modest to keep the wireless RAM
      footprint reasonable.
```

## dts/bindings/behaviors/zmk,behavior-pmw3360-burst-accumulation-cycle.yaml
```yaml
description: PMW3360 burst accumulation cycle behavior

compatible: "zmk,behavior-pmw3360-burst-accumulation-cycle"

include: zero_param.yaml

properties:
  next:
    type: boolean
    description: If present, cycles burst accumulation forward; otherwise cycles backward.

  default-max-samples:
    type: int
    default: 12
    description: Initial burst accumulation limit assumed by the behavior at boot.
```

## dts/bindings/behaviors/zmk,behavior-pmw3360-cpi-cycle.yaml
```yaml
description: PMW3360 CPI cycle behavior

compatible: "zmk,behavior-pmw3360-cpi-cycle"

include: zero_param.yaml

properties:
  next:
    type: boolean
    description: If present, cycles CPI forward; otherwise cycles backward.

  default-cpi:
    type: int
    default: 400
    description: Initial CPI value assumed by the behavior at boot.
```

## dts/bindings/behaviors/zmk,behavior-pmw3360-save-settings.yaml
```yaml
description: PMW3360 save runtime settings behavior

compatible: "zmk,behavior-pmw3360-save-settings"

include: zero_param.yaml
```

## dts/bindings/input/pixart,pmw3360.yaml
```yaml
# Copyright (c) 2025 The ZMK Contributors
# SPDX-License-Identifier: MIT

description: |
  Driver binding for the PixArt PMW3360 optical motion sensor.

  The PMW3360 is a high-performance relative pointing sensor often used in mice
  and custom trackball builds. In a ZMK context it can be used for USB and BLE
  pointing devices. The sensor can either run from a dedicated motion interrupt
  pin or in polling mode when no motion pin is wired.

  For wireless BLE pointing devices the most important practical tuning knob is
  `burst-accumulation-max-samples`. It limits how many internal PMW3360 motion
  bursts may be combined into one HID report. Higher values reduce report rate
  pressure on the BLE link at the cost of slightly coarser time granularity.

compatible: "pixart,pmw3360"

include: spi-device.yaml

properties:
  power-gpios:
    type: phandle-array
    description: |
      Optional GPIO that switches external power to the PMW3360. Use this when
      the sensor is behind a transistor, load switch, or other power gate and
      should only be powered while a pointing layer is active.

  irq-gpios:
    type: phandle-array
    description: |
      Optional motion interrupt GPIO connected to the PMW3360 MOTION pin.
      Providing this property enables interrupt-driven operation, which is the
      recommended mode for low-latency pointing builds. If omitted, the driver
      falls back to polling the sensor at `polling-interval`.

  cpi:
    type: int
    default: 600
    description: |
      Cursor sensitivity in counts per inch. Higher CPI makes the pointer move
      farther for the same physical movement. The PMW3360 stores CPI in 100-CPI
      steps, so values are effectively quantized to multiples of 100. The
      driver accepts values in the practical runtime range 100 to 12000 CPI.

  rotate-90:
    type: boolean
    description: |
      Rotate the sensor coordinate system by 90 degrees clockwise. Use this when
      the PCB or sensor package is mounted rotated relative to the intended
      pointer orientation.

  rotate-180:
    type: boolean
    description: |
      Rotate the sensor coordinate system by 180 degrees.

  rotate-270:
    type: boolean
    description: |
      Rotate the sensor coordinate system by 270 degrees clockwise.

  angle-tune:
    type: int
    default: 0
    description: |
      Sensor angle tuning value written to the PMW3360 angle tuning register.
      This can compensate for small mechanical skew in the sensor mounting.
      Negative values rotate one way, positive values the other. A practical
      tuning range is -30 to 30.

  lift-height-3mm:
    type: boolean
    description: |
      Configure a higher lift-off distance of approximately 3 mm instead of the
      default 2 mm. This is mainly useful when the sensor or lens geometry makes
      tracking stop too early during lift-off.

  force-awake:
    type: boolean
    description: |
      Keep the PMW3360 out of its internal rest mode. This is useful when an
      external power gate already handles idle power and the build prioritizes
      low wake latency over the PMW3360's own internal power saving behavior.

  polling-interval:
    type: int
    default: 1000
    description: |
      Polling interval in microseconds when `irq-gpios` is not configured.
      Lower values increase responsiveness and CPU/SPI activity. Higher values
      reduce overhead but can make motion feel less immediate. Values should be
      positive.

  burst-accumulation-max-samples:
    type: int
    default: 12
    description: |
      Maximum number of PMW3360 motion bursts to accumulate into a single HID
      report before the driver flushes the summed delta to the host.

      A value of 1 disables burst accumulation and sends one host report per
      burst. Higher values reduce the chance of BLE report backlog on fast
      movement, but also make the time resolution of host-visible motion more
      coarse. The driver clamps runtime values into the practical range 1 to 64.

  invert-x:
    type: boolean
    description: |
      Invert the X axis after all sensor rotation handling has been applied.

  invert-y:
    type: boolean
    description: |
      Invert the Y axis after all sensor rotation handling has been applied.
```
